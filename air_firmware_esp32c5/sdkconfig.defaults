## air_firmware_esp32c5/sdkconfig.defaults
```kconfig
# Enable SPIRAM
CONFIG_SPIRAM=y
CONFIG_SPIRAM_USE_MALLOC=y
CONFIG_ESPTOOLPY_FLASHSIZE_8MB=y


#CONFIG_ESPTOOLPY_NO_STUB=y
#CONFIG_ESP_CONSOLE_USB_SERIAL_JTAG=y

#CONFIG_SPIRAM_MODE_OCT=y

CONFIG_ESP_WIFI_STATIC_RX_BUFFER_NUM=4
CONFIG_ESP_WIFI_DYNAMIC_RX_BUFFER_NUM=16
CONFIG_ESP_WIFI_STATIC_TX_BUFFER_NUM=4

#adds ~8kb RAM
CONFIG_ESP_WIFI_RX_IRAM_OPT=n

#can free ~6kb
#CONFIG_ESP_WIFI_IRAM_OPT=n

CONFIG_ESP_SYSTEM_PANIC_REBOOT_DELAY_SECONDS=5

#should use port 0, because port 1 is LP port
CONFIG_SCCB_HARDWARE_I2C_PORT0=y

CONFIG_COMPILER_OPTIMIZATION_PERF=y

CONFIG_SPIRAM_SPEED_80M=y
CONFIG_SPIRAM_SPEED=80
```
